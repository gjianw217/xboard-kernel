## arch/arm/configs/real6410_defconfig
```kconfig
CONFIG_ARCH_MULTI_V6=y
CONFIG_ARCH_S3C64XX=y
CONFIG_MACH_REAL6410=y
CONFIG_REAL6410_SD_CH1=y
CONFIG_SERIAL_SAMSUNG=y
CONFIG_SERIAL_SAMSUNG_CONSOLE=y
CONFIG_MMC=y
CONFIG_MMC_SDHCI=y
CONFIG_MMC_SDHCI_S3C=y
CONFIG_EXT3_FS=y
CONFIG_DEBUG_USER=y
```
